/*
 * Copyright (c) 2020-2023, Vision Components GmbH.  All rights reserved.
 *
 * This program is free software; you can redistribute it and/or modify
 * it under the terms of the GNU General Public License as published by
 * the Free Software Foundation; either version 2 of the License, or
 * (at your option) any later version.
 *
 * This program is distributed in the hope that it will be useful, but WITHOUT
 * ANY WARRANTY; without even the implied warranty of MERCHANTABILITY or
 * FITNESS FOR A PARTICULAR PURPOSE.  See the GNU General Public License for
 * more details.
 *
 * You should have received a copy of the GNU General Public License
 * along with this program.  If not, see <http://www.gnu.org/licenses/>.
 */

#include <dt-bindings/media/camera.h>
#include <dt-bindings/version.h>

// ------------------------------------------------------------------------------------------------
//  Driver Configuration for NVIDIA Jetson Xavier NX on Auvidea JNX30-LC-PD
// ------------------------------------------------------------------------------------------------
#define VC_MIPI_CAM_AB      1   // 1: Enabled, 0: Disabled  (serial_a => CSI Port 0 => VI Stream 0)
#define VC_MIPI_CAM_CD      1   // 1: Enabled, 0: Disabled  (serial_e => CSI Port 4 => VI Stream 4)
#define VC_MIPI_CAM_E       0   // 1: Enabled, 0: Disabled  (serial_c => CSI Port 2 => VI Stream 2)
#define VC_MIPI_CAM_F       0   // 1: Enabled, 0: Disabled  (serial_d => CSI Port 3 => VI Stream 3)
// ------------------------------------------------------------------------------------------------
//  Supported number of lanes
// -----+------------------------------------------------------------------------------------------
//  1   | OV7251, IMX296, IMX297
//  2   | OV9281, IMX264, IMX265
//  2,4 | IMX178, IMX183, IMX226, IMX250, IMX252, IMX273, IMX290, IMX327, IMX335, IMX392, 
//      | IMX412, IMX415, IMX462, IMX565, IMX566, IMX567, IMX568, IMX900
// -----+------------------------------------------------------------------------------------------
#define VC_MIPI_LANES       2   // 1, 2, 4 Lanes
// ------------------------------------------------------------------------------------------------
//  Embedded Metadata Height
// -----+------------------------------------------------------------------------------------------
//  0   | IMX178, IMX183, IMX226, IMX250, IMX252, IMX264, IMX265, IMX273, IMX392, OV7251, OV9281
//  1   | IMX290, IMX327, IMX335, IMX415, IMX462, IMX565, IMX566, IMX567, IMX568, IMX900
//  2   | IMX296, IMX297, IMX412
// -----+------------------------------------------------------------------------------------------
#define VC_MIPI_METADATA_H  "1" // "0", "1", "2" Lines of meta data
// ------------------------------------------------------------------------------------------------
//   Sensor Manufacturer
// -----+------------------------------------------------------------------------------------------
//   1  | Sony Sensor (IMX)
//   2  | Omni Vision Sensor (OV)
// -----+------------------------------------------------------------------------------------------
#define VC_MIPI_MANUFACTURER 1
// ------------------------------------------------------------------------------------------------
//  GStreamer Support
// ------------------------------------------------------------------------------------------------
//  If you want to use GStreamer with nvarguscamerasrc you have to adjust this settings in the 
//  device tree below. The sections which have to be modified are marked by a comment. 
//  To find the correct parameter values please follow the instruction in the main README.md of 
//  this repository https://github.com/VC-MIPI-modules/vc_mipi_nvidia#gstreamer-support
// ------------------------------------------------------------------------------------------------

#if VC_MIPI_LANES == 1
    #define BUS_WIDTH 1
    #define NUM_LANES "1" 
    #define NUM_CSI_LANES 2
#endif
#if VC_MIPI_LANES == 2
    #define BUS_WIDTH 2
    #define NUM_LANES "2" 
    #define NUM_CSI_LANES 4
#endif
#if VC_MIPI_LANES == 4
    #define BUS_WIDTH 4
    #define NUM_LANES "4" 
    #define NUM_CSI_LANES 8
#endif

#if VC_MIPI_CAM_AB == 1 && VC_MIPI_CAM_CD == 1
    #define VC_MIPI_CAMERAS 2
#else
    #define VC_MIPI_CAMERAS 1
#endif

/ {
#if LINUX_VERSION < 500
        host1x {
                vc_vi_base: vi@15c10000 {
#else
        tegra-capture-vi  {
#endif
                        num-channels = <VC_MIPI_CAMERAS>;
                        ports {
                                #address-cells = <1>;
                                #size-cells = <0>;

#if VC_MIPI_CAM_AB == 1
                                vc_vi_port0: port@0 {
                                        reg = <0>;
                                        vc_vi_in0: endpoint {
                                                port-index = <0>;
                                                bus-width = <BUS_WIDTH>;
                                                remote-endpoint = <&vc_csi_out0>;
                                        };
                                };
#endif
#if VC_MIPI_CAM_CD == 1
                                vc_vi_port1: port@1 {
                                        reg = <1>;
                                        vc_vi_in1: endpoint {
                                                port-index = <4>;
                                                bus-width = <BUS_WIDTH>;
                                                remote-endpoint = <&vc_csi_out1>;
                                        };
                                };
#endif
#if VC_MIPI_CAM_E == 1
                                vc_vi_port2: port@2 {
                                        reg = <2>;
                                        vc_vi_in2: endpoint {
                                                port-index = <2>;
                                                bus-width = <BUS_WIDTH>;
                                                remote-endpoint = <&vc_csi_out2>;
                                        };
                                };
#endif
#if VC_MIPI_CAM_F == 1
                                vc_vi_port3: port@3 {
                                        reg = <3>;
                                        vc_vi_in3: endpoint {
                                                port-index = <3>;
                                                bus-width = <BUS_WIDTH>;
                                                remote-endpoint = <&vc_csi_out3>;
                                        };
                                };
#endif
                        }; // ports
                };

#if LINUX_VERSION < 500

        vc_csi_base: nvcsi@15a00000 {
#else
        host1x@13e00000 {
                nvcsi@15a00000 {
#endif
                        num-channels = <VC_MIPI_CAMERAS>;
                        #address-cells = <1>;
                        #size-cells = <0>;

#if VC_MIPI_CAM_AB == 1
                        vc_csi_chan0: channel@0 {
                                reg = <0>;
                                ports {
                                        #address-cells = <1>;
                                        #size-cells = <0>;
                                        vc_csi_chan0_port0: port@0 {
                                                reg = <0>;
                                                vc_csi_in0: endpoint@0 {
                                                        port-index = <0>;
                                                        bus-width = <BUS_WIDTH>;
                                                        remote-endpoint = <&vc_mipi_out0>;
                                                };
                                        };
                                        vc_csi_chan0_port1: port@1 {
                                                reg = <1>;
                                                vc_csi_out0: endpoint@1 {
                                                        remote-endpoint = <&vc_vi_in0>;
                                                };
                                        };
                                };
                        };
#endif

#if VC_MIPI_CAM_CD == 1
                        vc_csi_chan1: channel@1 {
                                reg = <1>;
                                ports {
                                        #address-cells = <1>;
                                        #size-cells = <0>;
                                        vc_csi_chan1_port0: port@0 {
                                                reg = <0>;
                                                vc_csi_in1: endpoint@2 {
                                                        port-index = <4>;
                                                        bus-width = <BUS_WIDTH>;
                                                        remote-endpoint = <&vc_mipi_out1>;
                                                };
                                        };
                                        vc_csi_chan1_port1: port@1 {
                                                reg = <1>;
                                                vc_csi_out1: endpoint@3 {
                                                        remote-endpoint = <&vc_vi_in1>;
                                                };
                                        };
                                };
                        };
#endif

#if VC_MIPI_CAM_E == 1
                        vc_csi_chan2: channel@2 {
                                reg = <2>;
                                ports {
                                        #address-cells = <1>;
                                        #size-cells = <0>;
                                        vc_csi_chan2_port0: port@0 {
                                                reg = <0>;
                                                vc_csi_in2: endpoint@4 {
                                                        port-index = <2>;
                                                        bus-width = <1>;
                                                        remote-endpoint = <&vc_mipi_out2>;
                                                };
                                        };
                                        vc_csi_chan2_port1: port@1 {
                                                reg = <1>;
                                                vc_csi_out2: endpoint@5 {
                                                        remote-endpoint = <&vc_vi_in2>;
                                                };
                                        };
                                };
                        };
#endif

#if VC_MIPI_CAM_F == 1
                        vc_csi_chan3: channel@3 {
                                reg = <3>;
                                ports {
                                        #address-cells = <1>;
                                        #size-cells = <0>;
                                        vc_csi_chan3_port0: port@0 {
                                                reg = <0>;
                                                vc_csi_in3: endpoint@6 {
                                                        port-index = <3>;
                                                        bus-width = <1>;
                                                        remote-endpoint = <&vc_mipi_out3>;
                                                };
                                        };
                                        vc_csi_chan3_port1: port@1 {
                                                reg = <1>;
                                                vc_csi_out3: endpoint@7 {
                                                        remote-endpoint = <&vc_vi_in3>;
                                                };
                                        };
                                };
                        };
#endif

#if LINUX_VERSION >= 500
                };
#endif
        };

#if LINUX_VERSION < 500
        };
#endif

#if VC_MIPI_CAM_AB == 1
        i2c@3180000 {
#if VC_MIPI_MANUFACTURER == 1
        vc_mipi_cam0: vc_mipi@1a {
                        reg                     = <0x1a>;
#else
        vc_mipi_cam0: vc_mipi@60 {
                        reg                     = <0x60>;
#endif
                        compatible              = "nvidia,vc_mipi";
                        devnode                 = "video0";
                        use_sensor_mode_id      = "false";
                        sensor_model            = "vc_mipi";

                        num_lanes               = NUM_LANES;
                        trigger_mode            = "0";
                        io_mode                 = "0";

                        // ----------------------------------------------------
                        // If you want to use GStreamer with nvarguscamerasrc
                        // you have to adjust this settings
                        physical_w              = "1.000";
                        physical_h              = "1.000";
                        // ----------------------------------------------------

                        // This node is needed by the Tegra framework.
                        // You don't have to change any settings if just want to use the V4L API.
                        mode0 {
                                num_lanes                = NUM_LANES;
                                tegra_sinterface         = "serial_a";
                                embedded_metadata_height = VC_MIPI_METADATA_H;
                                readout_orientation      = "0";

                                // ----------------------------------------------------
                                // If you want to use GStreamer with nvarguscamerasrc
                                // you have to adjust this settings. 
                                active_l                 = "0";
                                active_t                 = "0";
                                active_w                 = "0";
                                active_h                 = "0";

#if LINUX_VERSION < 500
                                pixel_t                  = "bayer_rggb";
#else
                                mode_type                = "bayer";
                                pixel_phase              = "rggb";
                                csi_pixel_bit_depth      = "10";
#endif
                                min_gain_val             = "0";         // mdB
                                max_gain_val             = "48000";     // mdB
                                step_gain_val            = "100";       // mdB
                                default_gain             = "0";         // mdB

                                min_exp_time             = "1";         // us
                                max_exp_time             = "1000000";   // us
                                step_exp_time            = "1";         // us
                                default_exp_time         = "10000";     // us

                                // For applications like argus_camera, there should
                                // be a minimal frame rate greater than zero!
                                min_framerate            = "1000";      // mHz
                                max_framerate            = "60000";     // mHz
                                step_framerate           = "100";       // mHz
                                default_framerate        = "60000";     // mHz
                                // ----------------------------------------------------

                                gain_factor              = "1000";
                                exposure_factor          = "1000000";
                                framerate_factor         = "1000";
                                inherent_gain            = "1";
                                min_hdr_ratio            = "1";
                                max_hdr_ratio            = "1";

                                line_length              = "0";
                                phy_mode                 = "DPHY";
                                discontinuous_clk        = "no";
                                mclk_khz                 = "24000";

#if LINUX_VERSION < 500
                                pix_clk_hz               = "800000000";
#else
                                pix_clk_hz               = "74250000";
#endif

                                mclk_multiplier          = "9.33";
                                cil_settletime           = "0";
                                dpcm_enable              = "false";
                        };

                        ports {
                                #address-cells = <1>;
                                #size-cells = <0>;
                                port@0 {
                                        reg = <0>;
                                        vc_mipi_out0: endpoint {
                                                port-index = <0>;
                                                bus-width = <BUS_WIDTH>;
                                                remote-endpoint = <&vc_csi_in0>;
                                        };
                                };
                        };
                };
        };
#endif // VC_MIPI_CAM_AB

#if VC_MIPI_CAM_CD == 1
        i2c@c240000 {
#if VC_MIPI_MANUFACTURER == 1
        vc_mipi_cam1: vc_mipi@1a {
                        reg                     = <0x1a>;
#else
        vc_mipi_cam1: vc_mipi@60 {
                        reg                     = <0x60>;
#endif
                        compatible              = "nvidia,vc_mipi";
                        devnode                 = "video1";
                        use_sensor_mode_id      = "false";
                        sensor_model            = "vc_mipi";

                        num_lanes               = NUM_LANES;
                        trigger_mode            = "0";
                        io_mode                 = "0";

                        // ----------------------------------------------------
                        // If you want to use GStreamer with nvarguscamerasrc
                        // you have to adjust this settings
                        physical_w              = "1.000";
                        physical_h              = "1.000";
                        // ----------------------------------------------------

                        // This node is needed by the Tegra framework.
                        // You don't have to change any settings if just want to use the V4L API.
                        mode0 {
                                num_lanes                = NUM_LANES;
                                tegra_sinterface         = "serial_e";
                                embedded_metadata_height = VC_MIPI_METADATA_H;
                                readout_orientation      = "0";

                                // ----------------------------------------------------
                                // If you want to use GStreamer with nvarguscamerasrc
                                // you have to adjust this settings. 
                                active_l                 = "0";
                                active_t                 = "0";
                                active_w                 = "0";
                                active_h                 = "0";

#if LINUX_VERSION < 500
                                pixel_t                  = "bayer_rggb";
#else
                                mode_type                = "bayer";
                                pixel_phase              = "rggb";
                                csi_pixel_bit_depth      = "10";
#endif
                                min_gain_val             = "0";         // mdB
                                max_gain_val             = "48000";     // mdB
                                step_gain_val            = "100";       // mdB
                                default_gain             = "0";         // mdB

                                min_exp_time             = "1";         // us
                                max_exp_time             = "1000000";   // us
                                step_exp_time            = "1";         // us
                                default_exp_time         = "10000";     // us

                                // For applications like argus_camera, there should 
                                // be a minimal frame rate greater than zero!
                                min_framerate            = "1000";      // mHz
                                max_framerate            = "60000";     // mHz
                                step_framerate           = "100";       // mHz
                                default_framerate        = "60000";     // mHz
                                // ----------------------------------------------------

                                gain_factor              = "1000";
                                exposure_factor          = "1000000";
                                framerate_factor         = "1000";
                                inherent_gain            = "1";
                                min_hdr_ratio            = "1";
                                max_hdr_ratio            = "1";

                                line_length              = "0";
                                phy_mode                 = "DPHY";
                                discontinuous_clk        = "no";
                                mclk_khz                 = "24000";

#if LINUX_VERSION < 500
                                pix_clk_hz               = "800000000";
#else
                                pix_clk_hz               = "74250000";
#endif

                                mclk_multiplier          = "9.33";
                                cil_settletime           = "0";
                                dpcm_enable              = "false";
                        };

                        ports {
                                #address-cells = <1>;
                                #size-cells = <0>;
                                port@0 {
                                        reg = <0>;
                                        vc_mipi_out1: endpoint {
                                                port-index = <4>;
                                                bus-width = <BUS_WIDTH>;
                                                remote-endpoint = <&vc_csi_in1>;
                                        };
                                };
                        };
                };
        };
#endif // VC_MIPI_CAM_CD

#if VC_MIPI_CAM_E == 1
        i2c@31e0000 {
#if VC_MIPI_MANUFACTURER == 1
        vc_mipi_cam2: vc_mipi@1a {
                        reg                     = <0x1a>;
#else
        vc_mipi_cam2: vc_mipi@60 {
                        reg                     = <0x60>;
#endif
                        compatible              = "nvidia,vc_mipi";
                        devnode                 = "video2";
                        use_sensor_mode_id      = "false";
                        sensor_model            = "vc_mipi";

                        num_lanes               = NUM_LANES;
                        trigger_mode            = "0";
                        io_mode                 = "0";

                        // ----------------------------------------------------
                        // If you want to use GStreamer with nvarguscamerasrc
                        // you have to adjust this settings
                        physical_w              = "1.000";
                        physical_h              = "1.000";
                        // ----------------------------------------------------

                        // This node is needed by the Tegra framework.
                        // You don't have to change any settings if just want to use the V4L API.
                        mode0 {
                                num_lanes                = NUM_LANES;
                                tegra_sinterface         = "serial_c";
                                embedded_metadata_height = VC_MIPI_METADATA_H;
                                readout_orientation      = "0";

                                // ----------------------------------------------------
                                // If you want to use GStreamer with nvarguscamerasrc
                                // you have to adjust this settings. 
                                active_l                 = "0";
                                active_t                 = "0";
                                active_w                 = "0";
                                active_h                 = "0";

#if LINUX_VERSION < 500
                                pixel_t                  = "bayer_rggb";
#else
                                mode_type                = "bayer";
                                pixel_phase              = "rggb";
                                csi_pixel_bit_depth      = "10";
#endif

                                min_gain_val             = "0";         // mdB
                                max_gain_val             = "48000";     // mdB
                                step_gain_val            = "100";       // mdB
                                default_gain             = "0";         // mdB

                                min_exp_time             = "1";         // us
                                max_exp_time             = "1000000";   // us
                                step_exp_time            = "1";         // us
                                default_exp_time         = "10000";     // us

                                // For applications like argus_camera, there should
                                //  be a minimal frame rate greater than zero!
                                min_framerate            = "1000";      // mHz
                                max_framerate            = "60000";     // mHz
                                step_framerate           = "100";       // mHz
                                default_framerate        = "60000";     // mHz
                                // ----------------------------------------------------

                                gain_factor              = "1000";
                                exposure_factor          = "1000000";
                                framerate_factor         = "1000";
                                inherent_gain            = "1";
                                min_hdr_ratio            = "1";
                                max_hdr_ratio            = "1";

                                line_length              = "0";
                                phy_mode                 = "DPHY";
                                discontinuous_clk        = "no";
                                mclk_khz                 = "24000";

#if LINUX_VERSION < 500
                                pix_clk_hz               = "800000000";
#else
                                pix_clk_hz               = "74250000";
#endif

                                mclk_multiplier          = "9.33";
                                cil_settletime           = "0";
                                dpcm_enable              = "false";
                        };

                        ports {
                                #address-cells = <1>;
                                #size-cells = <0>;
                                port@0 {
                                        reg = <0>;
                                        vc_mipi_out2: endpoint {
                                                port-index = <2>;
                                                bus-width = <BUS_WIDTH>;
                                                remote-endpoint = <&vc_csi_in2>;
                                        };
                                };
                        };
                };
        };
#endif // VC_MIPI_CAM_E

#if VC_MIPI_CAM_F == 1
        i2c@c250000 {
#if VC_MIPI_MANUFACTURER == 1
        vc_mipi_cam3: vc_mipi@1a {
                        reg                     = <0x1a>;
#else
        vc_mipi_cam3: vc_mipi@60 {
                        reg                     = <0x60>;
#endif
                        compatible              = "nvidia,vc_mipi";
                        devnode                 = "video3";
                        use_sensor_mode_id      = "false";
                        sensor_model            = "vc_mipi";

                        num_lanes               = NUM_LANES;
                        trigger_mode            = "0";
                        io_mode                 = "0";

                        // ----------------------------------------------------
                        // If you want to use GStreamer with nvarguscamerasrc
                        // you have to adjust this settings
                        physical_w              = "1.000";
                        physical_h              = "1.000";
                        // ----------------------------------------------------

                        // This node is needed by the Tegra framework.
                        // You don't have to change any settings if just want to use the V4L API.
                        mode0 {
                                num_lanes                = NUM_LANES;
                                tegra_sinterface         = "serial_d";
                                embedded_metadata_height = VC_MIPI_METADATA_H;
                                readout_orientation      = "0";

                                // ----------------------------------------------------
                                // If you want to use GStreamer with nvarguscamerasrc
                                // you have to adjust this settings. 
                                active_l                 = "0";
                                active_t                 = "0";
                                active_w                 = "0";
                                active_h                 = "0";

#if LINUX_VERSION < 500
                                pixel_t                  = "bayer_rggb";
#else
                                mode_type                = "bayer";
                                pixel_phase              = "rggb";
                                csi_pixel_bit_depth      = "10";
#endif

                                min_gain_val             = "0";         // mdB
                                max_gain_val             = "48000";     // mdB
                                step_gain_val            = "100";       // mdB
                                default_gain             = "0";         // mdB

                                min_exp_time             = "1";         // us
                                max_exp_time             = "1000000";   // us
                                step_exp_time            = "1";         // us
                                default_exp_time         = "10000";     // us

                                // For applications like argus_camera, there should
                                // be a minimal frame rate greater than zero!
                                min_framerate            = "1000";      // mHz
                                max_framerate            = "60000";     // mHz
                                step_framerate           = "100";       // mHz
                                default_framerate        = "60000";     // mHz
                                // ----------------------------------------------------

                                gain_factor              = "1000";
                                exposure_factor          = "1000000";
                                framerate_factor         = "1000";
                                inherent_gain            = "1";
                                min_hdr_ratio            = "1";
                                max_hdr_ratio            = "1";

                                line_length              = "0";
                                phy_mode                 = "DPHY";
                                discontinuous_clk        = "no";
                                mclk_khz                 = "24000";

#if LINUX_VERSION < 500
                                pix_clk_hz               = "800000000";
#else
                                pix_clk_hz               = "74250000";
#endif

                                mclk_multiplier          = "9.33";
                                cil_settletime           = "0";
                                dpcm_enable              = "false";
                        };

                        ports {
                                #address-cells = <1>;
                                #size-cells = <0>;
                                port@0 {
                                        reg = <0>;
                                        vc_mipi_out3: endpoint {
                                                port-index = <3>;
                                                bus-width = <BUS_WIDTH>;
                                                remote-endpoint = <&vc_csi_in3>;
                                        };
                                };
                        };
                };
        };
#endif // VC_MIPI_CAM_F

        lens@vc_mipi {
                min_focus_distance  = "0.0";
                hyper_focal         = "0.0";
                focal_length        = "6.0";
                f_number            = "2.0";
                aperture            = "0.0";
        };
};

/ {
        tcp: tegra-camera-platform {
                compatible = "nvidia, tegra-camera-platform";
                
                num_csi_lanes = <NUM_CSI_LANES>;
                max_lane_speed = <1500000>;
                min_bits_per_pixel = <10>;
                vi_peak_byte_per_pixel = <2>;
                vi_bw_margin_pct = <25>;
                max_pixel_rate = <240000>;
                isp_peak_byte_per_pixel = <5>;
                isp_bw_margin_pct = <25>;

                modules {
#if VC_MIPI_CAM_AB == 1
                        cam_module0: module0 {
                                status = "okay";
                                badge = "jakku_topleft_vc_mipi";
                                position = "topleft";
                                orientation = "1";
                                cam_module0_drivernode0: drivernode0 {
                                        status = "okay";
                                        pcl_id = "v4l2_sensor";
#if VC_MIPI_MANUFACTURER == 1
                                        devname = "vc_mipi 2-001a";
                                        proc-device-tree = "/proc/device-tree/i2c@3180000/vc_mipi@1a";
#else
                                        devname = "vc_mipi 2-0060";
                                        proc-device-tree = "/proc/device-tree/i2c@3180000/vc_mipi@60";
#endif
                                };
                                cam_module0_drivernode1: drivernode1 {
                                        status = "okay";
                                        pcl_id = "v4l2_lens";
                                        proc-device-tree = "/proc/device-tree/lens@vc_mipi/";
                                };
                        };
#endif // VC_MIPI_CAM_AB

#if VC_MIPI_CAM_CD == 1
                        cam_module1: module1 {
                                status = "okay";
                                badge = "jakku_topright_vc_mipi";
                                position = "topright";
                                orientation = "1";
                                cam_module1_drivernode0: drivernode0 {
                                        status = "okay";
                                        pcl_id = "v4l2_sensor";
#if VC_MIPI_MANUFACTURER == 1
                                        devname = "vc_mipi 1-001a";
                                        proc-device-tree = "/proc/device-tree/i2c@c240000/vc_mipi@1a";
#else
                                        devname = "vc_mipi 1-0060";
                                        proc-device-tree = "/proc/device-tree/i2c@c240000/vc_mipi@60";
#endif
                                };
                                cam_module1_drivernode1: drivernode1 {
                                        status = "okay";
                                        pcl_id = "v4l2_lens";
                                        proc-device-tree = "/proc/device-tree/lens@vc_mipi/";
                                };
                        };
#endif // VC_MIPI_CAM_CD

#if VC_MIPI_CAM_E == 1
                        cam_module2: module2 {
                                status = "okay";
                                badge = "jakku_bottomleft_vc_mipi";
                                position = "bottomleft";
                                orientation = "1";
                                cam_module2_drivernode0: drivernode0 {
                                        status = "okay";
                                        pcl_id = "v4l2_sensor";
#if VC_MIPI_MANUFACTURER == 1
                                        devname = "vc_mipi 8-001a";
                                        proc-device-tree = "/proc/device-tree/i2c@31e0000/vc_mipi@1a";
#else
                                        devname = "vc_mipi 8-0060";
                                        proc-device-tree = "/proc/device-tree/i2c@31e0000/vc_mipi@60";
#endif
                                };
                                cam_module2_drivernode1: drivernode1 {
                                        status = "okay";
                                        pcl_id = "v4l2_lens";
                                        proc-device-tree = "/proc/device-tree/lens@vc_mipi/";
                                };
                        };
#endif // VC_MIPI_CAM_E

#if VC_MIPI_CAM_F == 1
                        cam_module3: module3 {
                                status = "okay";
                                badge = "jakku_bottomright_vc_mipi";
                                position = "bottomright";
                                orientation = "1";
                                cam_module3_drivernode0: drivernode0 {
                                        status = "okay";
                                        pcl_id = "v4l2_sensor";
#if VC_MIPI_MANUFACTURER == 1
                                        devname = "vc_mipi 7-001a";
                                        proc-device-tree = "/proc/device-tree/i2c@c250000/vc_mipi@1a";
#else
                                        devname = "vc_mipi 7-0060";
                                        proc-device-tree = "/proc/device-tree/i2c@c250000/vc_mipi@60";
#endif
                                };
                                cam_module3_drivernode1: drivernode1 {
                                        status = "okay";
                                        pcl_id = "v4l2_lens";
                                        proc-device-tree = "/proc/device-tree/lens@vc_mipi/";
                                };
                        };
#endif // VC_MIPI_CAM_F
                };
        };
};

#define CAM0_PWDN	TEGRA194_MAIN_GPIO(P, 5)
#define CAM1_PWDN	TEGRA194_MAIN_GPIO(P, 4)
#define CAM2_PWDN	TEGRA194_MAIN_GPIO(Q, 5)
#define CAM3_PWDN	TEGRA194_MAIN_GPIO(Q, 6)
#define CAM_TRIGGER	TEGRA194_MAIN_GPIO(R, 0)

/ {
        /delete-node/ cam_i2cmux;

#if VC_MIPI_CAM_AB == 1
        i2c@3180000 {
                status = "okay";
#if VC_MIPI_MANUFACTURER == 1
            vc_mipi@1a {
#else
            vc_mipi@60 {
#endif
                        status = "okay";
                        reset-gpios = <&tegra_main_gpio CAM0_PWDN GPIO_ACTIVE_HIGH>;
                };
        };
#endif
#if VC_MIPI_CAM_CD == 1
        i2c@c240000 {
                status = "okay";
#if VC_MIPI_MANUFACTURER == 1
            vc_mipi@1a {
#else
            vc_mipi@60 {
#endif
                        status = "okay";
                        reset-gpios = <&tegra_main_gpio CAM1_PWDN GPIO_ACTIVE_HIGH>;
                };
        };
#endif
#if VC_MIPI_CAM_E == 1
        i2c@31e0000 {
                status = "okay";
#if VC_MIPI_MANUFACTURER == 1
            vc_mipi@1a {
#else
            vc_mipi@60 {
#endif
                        status = "okay";
                        reset-gpios = <&tegra_main_gpio CAM3_PWDN GPIO_ACTIVE_HIGH>;
                };
        };
#endif
#if VC_MIPI_CAM_F == 1
        i2c@c250000 {
                status = "okay";
#if VC_MIPI_MANUFACTURER == 1
            vc_mipi@1a {
#else
            vc_mipi@60 {
#endif
                        status = "okay";
                        reset-gpios = <&tegra_main_gpio CAM2_PWDN GPIO_ACTIVE_HIGH>;
                };
        };
#endif
        pinmux@2430000 {
                pinmux_default: common {
                        soc_gpio44_pr0 {
                                nvidia,pins = "soc_gpio44_pr0";
                                nvidia,function = "rsvd2";
                                nvidia,pull = <TEGRA_PIN_PULL_UP>;
                                nvidia,tristate = <TEGRA_PIN_DISABLE>;
                                nvidia,enable-input = <TEGRA_PIN_DISABLE>;
                                nvidia,io-high-voltage = <TEGRA_PIN_DISABLE>;
                                nvidia,lpdr = <TEGRA_PIN_DISABLE>;
                        };
                };
        };

        gpio@2200000 {
                camera-trigger-high {
                        status = "okay";
                        gpio-hog;
                        output-high;
                        gpios = <CAM_TRIGGER 0>;
                        label = "cam-trigger";
                };
        };
};
