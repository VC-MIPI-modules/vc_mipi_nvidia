/*
 * Copyright (c) 2020-2023, Vision Components GmbH.  All rights reserved.
 *
 * This program is free software; you can redistribute it and/or modify
 * it under the terms of the GNU General Public License as published by
 * the Free Software Foundation; either version 2 of the License, or
 * (at your option) any later version.
 *
 * This program is distributed in the hope that it will be useful, but WITHOUT
 * ANY WARRANTY; without even the implied warranty of MERCHANTABILITY or
 * FITNESS FOR A PARTICULAR PURPOSE.  See the GNU General Public License for
 * more details.
 *
 * You should have received a copy of the GNU General Public License
 * along with this program.  If not, see <http://www.gnu.org/licenses/>.
 */

#include <dt-bindings/media/camera.h>
#include <dt-bindings/version.h>

// ------------------------------------------------------------------------------------------------
//  Driver Configuration for NVIDIA Jetson Xavier NX on Auvidea JNX42-LM
//  On JNX42 carrier board, only one camera (Cam0) is supported for Nano, XavierNX and TX2NX
// ------------------------------------------------------------------------------------------------
//  Supported number of lanes
// -----+------------------------------------------------------------------------------------------
//  1   | OV7251, IMX296, IMX297
//  2   | OV9281, IMX264, IMX265
//  2,4 | IMX178, IMX183, IMX226, IMX250, IMX252, IMX273, IMX290, IMX327, IMX335, IMX392, 
//      | IMX412, IMX415, IMX462, IMX565, IMX566, IMX567, IMX568, IMX900
// -----+------------------------------------------------------------------------------------------
#define VC_MIPI_LANES       2   // 1, 2, 4 Lanes
// ------------------------------------------------------------------------------------------------
//  Embedded Metadata Height
// -----+------------------------------------------------------------------------------------------
//  0   | IMX178, IMX183, IMX226, IMX250, IMX252, IMX264, IMX265, IMX273, IMX392, OV7251, OV9281
//  1   | IMX290, IMX327, IMX335, IMX415, IMX462, IMX565, IMX566, IMX567, IMX568, IMX900
//  2   | IMX296, IMX297, IMX412
// -----+------------------------------------------------------------------------------------------
#define VC_MIPI_METADATA_H  "1" // "0", "1", "2" Lines of meta data
// ------------------------------------------------------------------------------------------------
//   Sensor Manufacturer
// -----+------------------------------------------------------------------------------------------
//   1  | Sony Sensor (IMX)
//   2  | Omni Vision Sensor (OV)
// -----+------------------------------------------------------------------------------------------
#define VC_MIPI_MANUFACTURER 1
// ------------------------------------------------------------------------------------------------
//  GStreamer Support
// ------------------------------------------------------------------------------------------------
//  If you want to use GStreamer with nvarguscamerasrc you have to adjust this settings in the 
//  device tree below. The sections which have to be modified are marked by a comment. 
//  To find the correct parameter values please follow the instruction in the main README.md of 
//  this repository https://github.com/VC-MIPI-modules/vc_mipi_nvidia#gstreamer-support
// ------------------------------------------------------------------------------------------------

#if VC_MIPI_LANES == 1
        #define BUS_WIDTH 1
        #define NUM_LANES "1" 
        #define NUM_CSI_LANES 2
#endif
#if VC_MIPI_LANES == 2
        #define BUS_WIDTH 2
        #define NUM_LANES "2" 
        #define NUM_CSI_LANES 4
#endif
#if VC_MIPI_LANES == 4
        #define BUS_WIDTH 4
        #define NUM_LANES "4" 
        #define NUM_CSI_LANES 8
#endif

/ {
#if LINUX_VERSION < 500
        host1x {
                vc_vi_base: vi@15c10000 {
#else
        tegra-capture-vi  {
#endif
                        num-channels = <1>;
                        ports {
                                #address-cells = <1>;
                                #size-cells = <0>;

                                vc_vi_port0: port@0 {
                                        reg = <0>;
                                        vc_vi_in0: endpoint {
                                                port-index = <0>;
                                                bus-width = <BUS_WIDTH>;
                                                remote-endpoint = <&vc_csi_out0>;
                                        };
                                };
                        }; // ports
                };

#if LINUX_VERSION < 500
        vc_csi_base: nvcsi@15a00000 {
#else
        host1x@13e00000 {
                nvcsi@15a00000 {
#endif
                        num-channels = <1>;
                        #address-cells = <1>;
                        #size-cells = <0>;

                        vc_csi_chan0: channel@0 {
                                reg = <0>;
                                ports {
                                        #address-cells = <1>;
                                        #size-cells = <0>;
                                        vc_csi_chan0_port0: port@0 {
                                                reg = <0>;
                                                vc_csi_in0: endpoint@0 {
                                                        port-index = <0>;
                                                        bus-width = <BUS_WIDTH>;
                                                        remote-endpoint = <&vc_mipi_out0>;
                                                };
                                        };
                                        vc_csi_chan0_port1: port@1 {
                                                reg = <1>;
                                                vc_csi_out0: endpoint@1 {
                                                        remote-endpoint = <&vc_vi_in0>;
                                                };
                                        };
                                };
                        };
#if LINUX_VERSION >= 500
                };
#endif
        };

#if LINUX_VERSION < 500
        };
#endif

        i2c@3180000 {
#if VC_MIPI_MANUFACTURER == 1
                vc_mipi_cam0: vc_mipi@1a {
                                reg                     = <0x1a>;
#else
                vc_mipi_cam0: vc_mipi@60 {
                                reg                     = <0x60>;
#endif
                                compatible              = "nvidia,vc_mipi";
                                devnode                 = "video0";
                                use_sensor_mode_id      = "false";
                                sensor_model            = "vc_mipi";

                                num_lanes               = NUM_LANES;
                                trigger_mode            = "0";
                                io_mode                 = "0";

                                // ----------------------------------------------------
                                // If you want to use GStreamer with nvarguscamerasrc
                                // you have to adjust this settings
                                physical_w              = "1.000";
                                physical_h              = "1.000";
                                // ----------------------------------------------------

                                // This node is needed by the Tegra framework.
                                // You don't have to change any settings if just want to use the V4L API.
                                mode0 {
                                        num_lanes                = NUM_LANES;
                                        tegra_sinterface         = "serial_a";
                                        embedded_metadata_height = VC_MIPI_METADATA_H;
                                        readout_orientation      = "0";

                                        // ----------------------------------------------------
                                        // If you want to use GStreamer with nvarguscamerasrc
                                        // you have to adjust this settings. 
                                        active_l                 = "0";
                                        active_t                 = "0";
                                        active_w                 = "0";
                                        active_h                 = "0";

#if LINUX_VERSION < 500
                                        pixel_t                  = "bayer_rggb";
#else
                                        mode_type                = "bayer";
                                        pixel_phase              = "rggb";
                                        csi_pixel_bit_depth      = "10";
#endif
                                        min_gain_val             = "0";         // mdB
                                        max_gain_val             = "48000";     // mdB
                                        step_gain_val            = "100";       // mdB
                                        default_gain             = "0";         // mdB

                                        min_exp_time             = "1";         // us
                                        max_exp_time             = "1000000";   // us
                                        step_exp_time            = "1";         // us
                                        default_exp_time         = "10000";     // us

                                        // For applications like argus_camera, there should be 
                                        // a minimal frame rate greater than zero!
                                        min_framerate            = "1000";      // mHz
                                        max_framerate            = "60000";     // mHz
                                        step_framerate           = "100";       // mHz
                                        default_framerate        = "60000";     // mHz
                                        // ----------------------------------------------------

                                        gain_factor              = "1000";
                                        exposure_factor          = "1000000";
                                        framerate_factor         = "1000";
                                        inherent_gain            = "1";
                                        min_hdr_ratio            = "1";
                                        max_hdr_ratio            = "1";

                                        line_length              = "0";
                                        phy_mode                 = "DPHY";
                                        discontinuous_clk        = "no";
                                        mclk_khz                 = "24000";
#if LINUX_VERSION < 500
                                        pix_clk_hz               = "800000000";
#else
                                        pix_clk_hz               = "74250000";
#endif

                                        mclk_multiplier          = "9.33";
                                        cil_settletime           = "0";
                                        dpcm_enable              = "false";
                                };

                                ports {
                                        #address-cells = <1>;
                                        #size-cells = <0>;
                                        port@0 {
                                                reg = <0>;
                                                vc_mipi_out0: endpoint {
                                                        port-index = <0>;
                                                        bus-width = <BUS_WIDTH>;
                                                        remote-endpoint = <&vc_csi_in0>;
                                                };
                                        };
                                };
                        };
                };

                lens@vc_mipi {
                        min_focus_distance  = "0.0";
                        hyper_focal         = "0.0";
                        focal_length        = "6.0";
                        f_number            = "2.0";
                        aperture            = "0.0";
                };
};

/ {
        tcp: tegra-camera-platform {
                compatible = "nvidia, tegra-camera-platform";

                num_csi_lanes = <NUM_CSI_LANES>;
                max_lane_speed = <1500000>;
                min_bits_per_pixel = <10>;
                vi_peak_byte_per_pixel = <2>;
                vi_bw_margin_pct = <25>;
                max_pixel_rate = <240000>;
                isp_peak_byte_per_pixel = <5>;
                isp_bw_margin_pct = <25>;

                modules {
                        cam_module0: module0 {
                                status = "okay";
                                badge = "jakku_topleft_vc_mipi";
                                position = "topleft";
                                orientation = "1";
                                cam_module0_drivernode0: drivernode0 {
                                        status = "okay";
                                        pcl_id = "v4l2_sensor";
#if VC_MIPI_MANUFACTURER == 1
                                        devname = "vc_mipi 2-001a";
                                        proc-device-tree = "/proc/device-tree/i2c@3180000/vc_mipi@1a";
#else
                                        devname = "vc_mipi 2-0060";
                                        proc-device-tree = "/proc/device-tree/i2c@3180000/vc_mipi@60";
#endif
                                };
                                cam_module0_drivernode1: drivernode1 {
                                        status = "okay";
                                        pcl_id = "v4l2_lens";
                                        proc-device-tree = "/proc/device-tree/lens@vc_mipi/";
                                };
                        };
                };
        };
};

#define CAM0_PWDN       TEGRA194_MAIN_GPIO(P, 5)
#define CAM1_PWDN       TEGRA194_MAIN_GPIO(P, 4)
#define CAM2_PWDN       TEGRA194_MAIN_GPIO(Q, 5)
#define CAM3_PWDN       TEGRA194_MAIN_GPIO(Q, 6)
#define CAM_TRIGGER     TEGRA194_MAIN_GPIO(R, 0)

/ {
        /delete-node/ cam_i2cmux;

        i2c@3180000 {
                status = "okay";
#if VC_MIPI_MANUFACTURER == 1
                vc_mipi@1a {
#else
                vc_mipi@60 {
#endif
                        status = "okay";
                        reset-gpios = <&tegra_main_gpio CAM0_PWDN GPIO_ACTIVE_HIGH>;
                };
        };

        pinmux@2430000 {
                pinmux_default: common {
                        soc_gpio44_pr0 {
                                nvidia,pins = "soc_gpio44_pr0";
                                nvidia,function = "rsvd2";
                                nvidia,pull = <TEGRA_PIN_PULL_UP>;
                                nvidia,tristate = <TEGRA_PIN_DISABLE>;
                                nvidia,enable-input = <TEGRA_PIN_DISABLE>;
                                nvidia,io-high-voltage = <TEGRA_PIN_DISABLE>;
                                nvidia,lpdr = <TEGRA_PIN_DISABLE>;
                        };
                };
        };

        gpio@2200000 {
                camera-trigger-high {
                        status = "okay";
                        gpio-hog;
                        output-high;
                        gpios = <CAM_TRIGGER 0>;
                        label = "cam-trigger";
                };
        };
};
